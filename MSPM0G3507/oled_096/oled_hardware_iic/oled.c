#include <stdlib.h>
#include <string.h>

#ifdef __cplusplus
#include <cstdlib>
#include <cstring>
#endif

#include <stdlib.h>
#include <string.h>

#include "oled.h"

#define system_delay_ms(m) delay_cycles((m * (CPUCLK_FREQ / 1000)))

volatile bool gDMAIICTransferred;
I2cControllerStatus gI2cControllerStatus;

static uint8_t OLED_buffer[1024] = {
    0x00, 0x00, 0x00, 0x00, 0x00, 0x00, 0x00, 0x00, 0x00, 0x00, 0x00, 0x00,
    0x00, 0x00, 0x00, 0x00, 0x00, 0x00, 0x00, 0x00, 0x00, 0x00, 0x00, 0x00,
    0x00, 0x00, 0x00, 0x00, 0x00, 0x00, 0x00, 0x00, 0x00, 0x00, 0x00, 0x00,
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    0x00, 0x00, 0x00, 0x00,
};

void OLED_WR_Byte(unsigned dat, unsigned cmd)
{
    uint16_t i;

    uint8_t gTxLen, gTxPacket[3];

    gTxLen = 2;
    gI2cControllerStatus = I2C_STATUS_IDLE;

    if (cmd)
        gTxPacket[0] = 0x40;
    else
        gTxPacket[0] = 0x00;
    gTxPacket[1] = dat;

    DL_I2C_fillControllerTXFIFO(I2C_0_INST, &gTxPacket[0], gTxLen);

    gI2cControllerStatus = I2C_STATUS_TX_STARTED;
    while (!(DL_I2C_getControllerStatus(I2C_0_INST) &
             DL_I2C_CONTROLLER_STATUS_IDLE))
        ;
    DL_I2C_startControllerTransfer(I2C_0_INST, I2C_TARGET_ADDRESS,
                                   DL_I2C_CONTROLLER_DIRECTION_TX, gTxLen);
    // Wait until the Controller sends all bytes
    while ((gI2cControllerStatus != I2C_STATUS_TX_COMPLETE) &&
           (gI2cControllerStatus != I2C_STATUS_ERROR))
    {
        __WFE();
    }
    while (DL_I2C_getControllerStatus(I2C_0_INST) &
           DL_I2C_CONTROLLER_STATUS_BUSY_BUS)
        ;
    if (DL_I2C_getControllerStatus(I2C_0_INST) & DL_I2C_CONTROLLER_STATUS_ERROR)
    {
        __BKPT(0);
    }

    while (
        !(DL_I2C_getControllerStatus(I2C_0_INST) & DL_I2C_CONTROLLER_STATUS_IDLE))
        ;
}

void OLED_Set_Pos(unsigned char x, unsigned char y)
{
    OLED_WR_Byte(YLevel + y / PAGE_SIZE, OLED_CMD);
    OLED_WR_Byte((((x + 2) & 0xf0) >> 4) | 0x10, OLED_CMD);
    OLED_WR_Byte(((x + 2) & 0x0f), OLED_CMD);
}

void OLED_Display_On(void)
{
    OLED_WR_Byte(0X8D, OLED_CMD); // SET DCDC
    OLED_WR_Byte(0X14, OLED_CMD); // DCDC ON
    OLED_WR_Byte(0XAF, OLED_CMD); // DISPLAY ON
}

void OLED_Display_Off(void)
{
    OLED_WR_Byte(0X8D, OLED_CMD); // SET DCDC
    OLED_WR_Byte(0X10, OLED_CMD); // DCDC OFF
    OLED_WR_Byte(0XAE, OLED_CMD); // DISPLAY OFF
}

/// @brief set one pixel in buffer
/// @param x
/// @param y
/// @param color 0 stands for white while 1 stands for black
void OLED_Set_Pixel(unsigned char x, unsigned char y, unsigned char color)
{
    if (x > 127 || y > 63) // Avoid crossing boundaries
        return;
    if (color)
    {
        OLED_buffer[(y / PAGE_SIZE) * WIDTH + x] |=
            (1 << (y % PAGE_SIZE)) & 0xff;
    }
    else
    {
        OLED_buffer[(y / PAGE_SIZE) * WIDTH + x] &=
            ~((1 << (y % PAGE_SIZE)) & 0xff);
    }
}

/// @brief negation one pixel
/// @param x
/// @param y
void OLED_Reverse_Pixel(uint8_t x, uint8_t y)
{
    if (x > 127 || y > 63) // Avoid crossing boundaries
        return;
    OLED_buffer[(y / PAGE_SIZE) * WIDTH + x] ^= (1 << (y % PAGE_SIZE)) & 0xff;
}

/// @brief write the buffer into screen control IC (using SPI with DMA to
/// accelerate)
/// @param void
void OLED_Display(void)
{
    uint8_t i, n;

    for (i = 0; i < PAGE_SIZE; i++)
    {
        OLED_WR_Byte(YLevel + i, OLED_CMD);
        OLED_WR_Byte(XLevelL, OLED_CMD);
        OLED_WR_Byte(XLevelH, OLED_CMD);
        for (n = 0; n < WIDTH; n++)
        {
            OLED_WR_Byte(OLED_buffer[i * WIDTH + n], OLED_DATA);
        }
    } // update full screen
}

/// @brief rewrite all bit in buffer to one specific state
/// @param dat
void OLED_Clear(unsigned dat)
{
    if (dat)
    {
        memset(OLED_buffer, 0xff, sizeof(OLED_buffer));
    }
    else
    {
        memset(OLED_buffer, 0, sizeof(OLED_buffer));
    }
    // OLED_Display();
}

uint8_t brightness;
uint8_t bright_last = 0, tran_sign = 0, tran_speed = 20;

/// @brief fadein and gradually brighten
/// @param x
void OLED_transition(uint8_t x)
{
    if (tran_sign)
    {
        if (x)
        {

            if (bright_last > brightness - tran_speed)
            {
                bright_last = brightness;
                OLED_WR_Byte(0x81, OLED_CMD);
                OLED_WR_Byte(bright_last, OLED_CMD);
                tran_sign = 0;
                return;
            }
            bright_last = bright_last + tran_speed;
            OLED_WR_Byte(0x81, OLED_CMD);
            OLED_WR_Byte(bright_last, OLED_CMD);
        }
        else
        {
            while (1)
            {
                if (bright_last < tran_speed)
                {
                    bright_last = 0;
                    OLED_WR_Byte(0x81, OLED_CMD);
                    OLED_WR_Byte(bright_last, OLED_CMD);
                    break;
                }
                OLED_WR_Byte(0x81, OLED_CMD);
                OLED_WR_Byte(bright_last, OLED_CMD);
                system_delay_ms(16);
                bright_last = bright_last - tran_speed;
            }
            system_delay_ms(16);
            tran_sign = 0;
        }
    }
}

/// @brief actually never needed
/// @param
void OLED_Init_GPIO(void) { ; }

/// @brief initialize the OLED
/// @param
void OLED_Init(void)
{
    NVIC_EnableIRQ(I2C_0_INST_INT_IRQN);
    system_delay_ms(200);

    OLED_WR_Byte(0xAE, OLED_CMD); //--turn off oled panel
    OLED_WR_Byte(0x00, OLED_CMD); //---set low column address
    OLED_WR_Byte(0x10, OLED_CMD); //---set high column address
    OLED_WR_Byte(0x40, OLED_CMD); //--set start line address  Set Mapping RAM
                                  // Display Start Line (0x00~0x3F)
    OLED_WR_Byte(0x81, OLED_CMD); //--set contrast control register
    OLED_WR_Byte(0xCF, OLED_CMD); // Set SEG Output Current Brightness
    OLED_WR_Byte(0xA1,
                 OLED_CMD); //--Set SEG/Column Mapping     0xa0左右反置 0xa1正常
    OLED_WR_Byte(
        0xC8, OLED_CMD); // Set COM/Row Scan Direction   0xc0上下反置 0xc8正常
    OLED_WR_Byte(0xA6, OLED_CMD); //--set normal display
    OLED_WR_Byte(0xA8, OLED_CMD); //--set multiplex ratio(1 to 64)
    OLED_WR_Byte(0x3f, OLED_CMD); //--1/64 duty
    OLED_WR_Byte(0xD3, OLED_CMD); //-set display offset	Shift Mapping RAM
                                  // Counter (0x00~0x3F)
    OLED_WR_Byte(0x00, OLED_CMD); //-not offset
    OLED_WR_Byte(
        0xd5, OLED_CMD); //--set display clock divide ratio/oscillator frequency
    OLED_WR_Byte(0x80,
                 OLED_CMD); //--set divide ratio, Set Clock as 100 Frames/Sec
    OLED_WR_Byte(0xD9, OLED_CMD); //--set pre-charge period
    OLED_WR_Byte(
        0xF1, OLED_CMD); // Set Pre-Charge as 15 Clocks & Discharge as 1 Clock
    OLED_WR_Byte(0xDA, OLED_CMD); //--set com pins hardware configuration
    OLED_WR_Byte(0x12, OLED_CMD);
    OLED_WR_Byte(0xDB, OLED_CMD); //--set vcomh
    OLED_WR_Byte(0x40, OLED_CMD); // Set VCOM Deselect Level
    OLED_WR_Byte(0x20, OLED_CMD); //-Set Page Addressing Mode (0x00/0x01/0x02)
    OLED_WR_Byte(0x02, OLED_CMD); //
    OLED_WR_Byte(0x8D, OLED_CMD); //--set Charge Pump enable/disable
    OLED_WR_Byte(0x14, OLED_CMD); //--set(0x10) disable
    OLED_WR_Byte(0xA4, OLED_CMD); // Disable Entire Display On (0xa4/0xa5)
    OLED_WR_Byte(0xA6, OLED_CMD); // Disable Inverse Display On (0xa6/a7)
    OLED_WR_Byte(0xAF, OLED_CMD); /*display ON*/
}

void I2C_0_INST_IRQHandler(void)
{
    switch (DL_I2C_getPendingInterrupt(I2C_0_INST))
    {
    case DL_I2C_IIDX_CONTROLLER_TX_DONE:
        gI2cControllerStatus = I2C_STATUS_TX_COMPLETE;
        break;
    case DL_I2C_IIDX_CONTROLLER_TXFIFO_TRIGGER:
        gI2cControllerStatus = I2C_STATUS_TX_INPROGRESS;
        break;
        /* Not used for this example */
    case DL_I2C_IIDX_CONTROLLER_ARBITRATION_LOST:
    case DL_I2C_IIDX_CONTROLLER_NACK:
        if ((gI2cControllerStatus == I2C_STATUS_RX_STARTED) ||
            (gI2cControllerStatus == I2C_STATUS_TX_STARTED))
        {
            /* NACK interrupt if I2C Target is disconnected */
            gI2cControllerStatus = I2C_STATUS_ERROR;
        }
    case DL_I2C_IIDX_CONTROLLER_RXFIFO_FULL:
    case DL_I2C_IIDX_CONTROLLER_TXFIFO_EMPTY:
    case DL_I2C_IIDX_CONTROLLER_START:
    case DL_I2C_IIDX_CONTROLLER_STOP:
    case DL_I2C_IIDX_CONTROLLER_EVENT1_DMA_DONE:
    case DL_I2C_IIDX_CONTROLLER_EVENT2_DMA_DONE:
    default:
        break;
    }
}
